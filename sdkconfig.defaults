## sdkconfig.defaults
```kconfig
CONFIG_PARTITION_TABLE_CUSTOM=y
CONFIG_PARTITION_TABLE_FILENAME="partitions.csv"
CONFIG_ESP_DEFAULT_CPU_FREQ_MHZ_240=y
CONFIG_ESP_DEFAULT_CPU_FREQ_MHZ=240
CONFIG_ESP_SYSTEM_EVENT_TASK_STACK_SIZE=16384
CONFIG_ESPTOOLPY_FLASHSIZE_4MB=y
CONFIG_ESPTOOLPY_FLASHSIZE="4MB"
```

## sdkconfig.defaults.esp32
```kconfig
CONFIG_ESP_TASK_WDT_CHECK_IDLE_TASK_CPU1=n
CONFIG_TASK_WDT_CHECK_IDLE_TASK_CPU1=n
```

## sdkconfig.defaults.esp32s2
```kconfig
CONFIG_ESP_CONSOLE_USB_CDC=y
CONFIG_ESP_CONSOLE_UART_NUM=-1
CONFIG_ESP_CONSOLE_ROM_SERIAL_PORT_NUM=3
CONFIG_ESP_CONSOLE_USB_CDC_RX_BUF_SIZE=64
CONFIG_ESP32S2_KEEP_USB_ALIVE=y
CONFIG_CONSOLE_UART_NUM=-1
```
